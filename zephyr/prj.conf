## CMakeLists.txt
```
# SPDX-License-Identifier: Apache-2.0

cmake_minimum_required(VERSION 3.20.0)

find_package(Zephyr REQUIRED HINTS $ENV{ZEPHYR_BASE})

zephyr_compile_options(-mcpu=cortex-a55)

project(fp16-test)

target_include_directories(app PRIVATE ../include ../common/include)

target_sources(app PRIVATE ../common/src/convld.c src/main.c)
```

## prj.conf
```kconfig
CONFIG_HEAP_MEM_POOL_SIZE=131072

CONFIG_ARMV8_A_NS=y

CONFIG_FPU=y
CONFIG_FPU_SHARING=y
```

## boards/mt8370_genio_510_pumpkin_mt8188_a55.overlay
```dts
/*
 * Copyright 2026 MediaTek
 *
 * SPDX-License-Identifier: Apache-2.0
 */

/ {
};

&gpio0_31 {
	status = "okay";
};

&uart1 {
	pinctrl-0 = <&uart1_default>;
	pinctrl-names = "default";
	current-speed = <115200>;
	status = "okay";
};
```

## src/main.c
```c
#include <stdio.h>
#include <stdlib.h>
#include <arm_neon.h>

#include <zephyr/kernel.h>

#include "convld.h"


#define FP16_THREAD_STACK_SIZE    2048


static struct k_thread fp16_thread;

static K_THREAD_STACK_DEFINE (fp16_stack, FP16_THREAD_STACK_SIZE);


void fp16_task () {
    size_t   out_idx;
    _Float16 out_scalar [SIGNAL_SIZE];      // Only out_scalar [OUT_SIZE] will be valid.
    _Float16 out_neon   [SIGNAL_SIZE];      // Only out_neon [OUT_SIZE] will be valid.


    // Clear output arrays
    for (out_idx = 0; out_idx < OUT_SIZE; out_idx++)
    {
        out_scalar [out_idx] = 0.0f16;
        out_neon   [out_idx] = 0.0f16;
    }

    // Run both implementations
    conv1d_scalar    (input, kernel, out_scalar);
    conv1d_neon_fp16 (input, kernel, out_neon);

    // Verify and Print Results
    printf("Index | Scalar FP16 | NEON FP16\n");
    printf("-------------------------------\n");
    for (out_idx = 0; out_idx < OUT_SIZE; out_idx++)
    {
        printf(" [%02zu] |   %5.2f    |   %5.2f\n", out_idx, (double) out_scalar [out_idx], (double) out_neon [out_idx]);
    }
}

int main (void)
{
    printf ("FP16-TEST ...\n");

	k_thread_create (&fp16_thread, fp16_stack, FP16_THREAD_STACK_SIZE, fp16_task, NULL, NULL, NULL, K_PRIO_COOP (7), 0, K_NO_WAIT);

	return (0);
}
```
